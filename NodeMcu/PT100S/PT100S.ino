#include <Wire.h>
float temp[] =
{
  22.83, 22.4, 21.97, 21.54, 21.11, 20.68, 20.25, 19.82, 19.38, 18.95,
  27.1, 26.67, 26.24, 25.82, 25.39, 24.97, 24.54, 24.11, 23.68, 23.25,
  31.34, 30.91, 30.49, 30.07, 29.64, 29.22, 28.8, 28.37, 27.95, 27.52,
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  387.55, 387.84, 388.14, 388.43, 388.72, 389.02, 389.31, 389.6, 389.9, 390.19
};
void setup()
{
  Serial.begin(115200);
  Serial.print("Hello World");
}

#define LOOPAVERAGE 1000
void loop()
{
  const int analogInPin = A0; //sensor connected to A0 pin
  float voltage;
  float resistance;

  int sensorValue = 0;
  unsigned int idx;
  unsigned int lookupidx;
  int sensortemp;


  while (1)
  {
    int avgsval = 0;
    float avgvolt = 0;
    float avgresist = 0;
    int avgsenstemp = 0;

    for (idx = 0; idx < LOOPAVERAGE; idx++)
    {
      sensorValue = analogRead(analogInPin);
      avgsval += sensorValue;
      if (idx == (LOOPAVERAGE - 1))
      {
        Serial.print("\r\n Sensor Value : ");
        Serial.print(avgsval / LOOPAVERAGE);
      }

      voltage = sensorValue * 3.3 / 1023.0;
      avgvolt += voltage;
      resistance = voltage * 2050 / (5 - voltage);
      avgresist += resistance;

      for (lookupidx = 0 ; lookupidx < sizeof(temp) ; lookupidx++)
      {
        if (temp[lookupidx] > resistance)
          break;
      }
      sensortemp = lookupidx - 200;
      avgsenstemp += sensortemp;

      if (idx == (LOOPAVERAGE - 1))
      {
        Serial.print("\r\n Voltage Value : ");
        Serial.print(avgvolt / LOOPAVERAGE);
        Serial.print(" Resistance Value : ");
        Serial.print(avgresist / LOOPAVERAGE);
        Serial.print(" Temp Value : ");
        Serial.print(avgsenstemp / LOOPAVERAGE);
      }
      delay(1); // interval of fetching data from sensor
    }
  }
}
